## firmware/sdkconfig.defaults.local
```kconfig
# stackchan-embodied self-host overlay (git-ignored upstream; canonical copy in
# stackchan-embodied/firmware/sdkconfig.defaults.local)
# Body relay: device → CloudFront(wss/https) → ALB(X-Origin-Verify) → EC2 Go server :12800
CONFIG_STACKCHAN_SERVER_URL="https://da8daz4hvc7q8.cloudfront.net:443"
# Voice brain OTA: device → CloudFront → ALB → xiaozhi-server :8003
CONFIG_OTA_URL="https://da8daz4hvc7q8.cloudfront.net/xiaozhi/ota/"
CONFIG_STACKCHAN_SKIN_GOUDAN=y
# 唤醒词: 三个狗蛋变体 (MultiNet 自定义, 分号分隔 — stackchan-embodied 多词补丁)
CONFIG_USE_AFE_WAKE_WORD=n
CONFIG_USE_CUSTOM_WAKE_WORD=y
CONFIG_CUSTOM_WAKE_WORD="hei gou dan;gou dan gou dan;ni hao gou dan"
CONFIG_CUSTOM_WAKE_WORD_DISPLAY="嘿狗蛋;狗蛋狗蛋;你好狗蛋"
CONFIG_CUSTOM_WAKE_WORD_THRESHOLD=8
# 中文 MultiNet 模型 (量化版 888K, 塞进 app 分区)
CONFIG_SR_MN_CN_MULTINET5_RECOGNITION_QUANT8=y
CONFIG_SR_MN_EN_NONE=y
```
